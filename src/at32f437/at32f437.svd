# AT32F437 register map
Vendor: Keil; Series: AT32F437; File version: 1.0
ARM 32-bit Cortex-M4 Microcontroller based device, CPU clock up to 288MHz, etc.
CPU: CM4 r0p1, little endian, no MPU, FPU, 4 interrupt priority bits
Registers are 32-bit, read-write, reset 0x0 unless marked. A register's access mark holds for its fields unless they carry their own. Offsets are from the block's base; lines under a group give offsets from that group; [hi:lo] are bit positions; {n}, {i} and the like mark numbered series; 'fields as' and 'values as' point back to an identical list; <NAME> marks a mode.

## Memory map
0x40000000 TMR2 size 0x400 — General purpose timer
0x40000050 TMR2_RMP size 0x4 — TMR2 remap register
0x40000400 TMR3 size 0x400 — General purpose timer
0x40000800 TMR4 size 0x400
0x40000C00 TMR5 size 0x400 — General purpose timer
0x40000C50 TMR5_RMP size 0x4 — TMR5 remap register
0x40001000 TMR6 size 0x400 — Basic timer
0x40001400 TMR7 size 0x400
0x40001800 TMR12 size 0x400
0x40001C00 TMR13 size 0x400
0x40002000 TMR14 size 0x400
0x40002800 ERTC size 0x400 — Real-time clock
0x40002C00 WWDT size 0x400 — Window watchdog
0x40003000 WDT size 0x400 — Watchdog
0x40003800 SPI2 size 0x400
0x40003C00 SPI3 size 0x400
0x40004400 USART2 size 0x400
0x40004800 USART3 size 0x400
0x40004C00 UART4 size 0x400 — Universal asynchronous receiver transmitter
0x40005000 UART5 size 0x400 — Universal asynchronous receiver transmitter
0x40005400 I2C1 size 0x400 — Inter-integrated circuit
0x40005800 I2C2 size 0x400
0x40005C00 I2C3 size 0x400
0x40006400 CAN1 size 0x400 — Can controller area network
0x40006800 CAN2 size 0x400
0x40007000 PWC size 0x400 — Power control
0x40007400 DAC size 0x400 — Digital to analog converter
0x40007800 UART7 size 0x400 — Universal asynchronous receiver transmitter
0x40007C00 UART8 size 0x400 — Universal asynchronous receiver transmitter
0x40010000 TMR1 size 0x400 — Advanced timer
0x40010400 TMR8 size 0x400
0x40011000 USART1 size 0x400 — Universal synchronous asynchronous receiver transmitter
0x40011400 USART6 size 0x400
0x40012000 ADC1 size 0x100 — Analog to digital converter
0x40012100 ADC2 size 0x100
0x40012200 ADC3 size 0x100
0x40012300 ADCCOM size 0x100 — ADC common area
0x40013000 SPI1 size 0x400 — Serial peripheral interface
0x40013400 SPI4 size 0x400
0x40013800 SCFG size 0x400 — System configuration controller
0x40013C00 EXINT size 0x400
0x40014000 TMR9 size 0x400 — General purpose timer
0x40014400 TMR10 size 0x400 — General purpose timer
0x40014800 TMR11 size 0x400
0x40014C00 TMR20 size 0x400
0x40017400 ACC size 0x400 — HICK Auto Clock Calibration
0x40017800 I2S2_EXT size 0x400
0x40017C00 I2S3_EXT size 0x400
0x40020000 GPIOA size 0x400 — General purpose I/Os
0x40020400 GPIOB size 0x400
0x40020800 GPIOC size 0x400
0x40020C00 GPIOD size 0x400
0x40021000 GPIOE size 0x400
0x40021400 GPIOF size 0x400
0x40021800 GPIOG size 0x400
0x40021C00 GPIOH size 0x400
0x40023000 CRC size 0x400 — CRC calculation unit
0x40023800 CRM size 0x400 — Clock and reset management
0x40023C00 FLASH size 0x400 — Flash memory controler
0x40026000 EDMA size 0x400 — EDMA controller
0x40026400 DMA1 size 0x200 — DMA controller
0x40026600 DMA2 size 0x200
0x40028000 ETHERNET_MAC size 0x100 — Ethernet: media access control
0x40028100 ETHERNET_MMC size 0x100 — Ethernet: MAC management counters
0x40028700 ETHERNET_PTP size 0x100 — Ethernet: Precision time protocol
0x40029000 ETHERNET_DMA size 0x100 — Ethernet: DMA controller operation
0x4002C400 SDIO1 size 0x400 — Secure digital input/output interface
0x40040000 USB_OTG2_GLOBAL size 0x400 — USB on the go full speed
0x40040400 USB_OTG2_HOST size 0x400 — USB on the go full speed
0x40040800 USB_OTG2_DEVICE size 0x400 — USB on the go full speed
0x40040E00 USB_OTG2_PWRCLK size 0x400 — USB on the go full speed
0x50000000 USB_OTG1_GLOBAL size 0x400 — USB on-the-go full speed
0x50000400 USB_OTG1_HOST size 0x400 — USB on the go full speed
0x50000800 USB_OTG1_DEVICE size 0x400 — USB on the go full speed
0x50000E00 USB_OTG1_PWRCLK size 0x400 — USB on the go full speed
0x50050000 DVP size 0x400 — Digital video parallel interface
0x50061000 SDIO2 size 0x400
0xA0000000 XMC size 0x1000 — Flexible static memory controller
0xA0001000 QSPI1 size 0x400 — Quad SPI Controller
0xA0002000 QSPI2 size 0x400
0xE000E000 NVIC size 0x1001 — Nested Vectored Interrupt Controller
0xE000EF34 FPU size 0xD — Floting point unit
0xE0042000 DEBUG size 0x400 — Debug support

## Interrupts
0 WWDT — Window Watchdog interrupt
1 PVM (EXINT) — PVM interrupt connect to EXINT line16
2 TAMPER (EXINT) — Tamper interrupt connect to EXINT line21
3 ERTC_WKUP (EXINT) — ERTC Global interrupt connect to EXINT line22
4 FLASH — Flash global interrupt
5 CRM — CRM global interrupt
6 EXINT0 (EXINT) — EXINT Line0 interrupt
7 EXINT1 (EXINT) — EXINT Line1 interrupt
8 EXINT2 (EXINT) — EXINT Line2 interrupt
9 EXINT3 (EXINT) — EXINT Line3 interrupt
10 EXINT4 (EXINT) — EXINT Line4 interrupt
11 EDMA_Stream1 (EDMA) — EDMA Stream1 global interrupt
12 EDMA_Stream2 (EDMA) — EDMA Stream2 global interrupt
13 EDMA_Stream3 (EDMA) — EDMA Stream3 global interrupt
14 EDMA_Stream4 (EDMA) — EDMA Stream4 global interrupt
15 EDMA_Stream5 (EDMA) — EDMA Stream5 global interrupt
16 EDMA_Stream6 (EDMA) — EDMA Stream6 global interrupt
17 EDMA_Stream7 (EDMA) — EDMA Stream7 global interrupt
18 ADC1_2_3 (ADC1) — ADC1,2,3 global interrupt
19 CAN1_TX (CAN1) — CAN1 TX interrupt
20 CAN1_RX0 (CAN1) — CAN1 RX0 interrupt
21 CAN1_RX1 (CAN1) — CAN1 RX1 interrupt
22 CAN1_SE (CAN1) — CAN1 SE interrupt
23 EXINT9_5 (EXINT) — EXINT Line[9:5] interrupts
24 TMR1_BRK_TMR9 (TMR1, TMR9) — TMR1 brake interrupt and TMR9 global interrupt
25 TMR1_OVF_TMR10 (TMR1, TMR10) — TMR1 overflow interrupt and TMR10 global interrupt
26 TMR1_TRG_HALL_TMR11 (TMR1, TMR11) — TMR1 trigger and HALL interrupts and TMR11 global interrupt
27 TMR1_CH (TMR1) — TMR1 channel interrupt
28 TMR2 — TMR2 global interrupt
29 TMR3 — TMR3 global interrupt
30 TMR4 — TMR4 global interrupt
31 I2C1_EVT (I2C1) — I2C1 event interrupt
32 I2C1_ERR (I2C1) — I2C1 error interrupt
33 I2C2_EVT (I2C2) — I2C2 event interrupt
34 I2C2_ERR (I2C2) — I2C2 error interrupt
35 SPI1 — SPI1 global interrupt
36 SPI2 — SPI2 global interrupt
37 USART1 — USART1 global interrupt
38 USART2 — USART2 global interrupt
39 USART3 — USART3 global interrupt
40 EXINT15_10 (EXINT) — EXINT Line[15:10] interrupts
41 ERTCALARM (EXINT) — ERTC Alarm interrupt connect to EXINT line17
42 OTGFS1_WKUP (EXINT) — OTGFS1_WKUP interrupt connect to EXINT line18
43 TMR8_BRK_TMR12 (TMR8, TMR12) — TMR8 brake interrupt and TMR12 global interrupt
44 TMR8_OVF_TMR13 (TMR8, TMR13) — TMR8 overflow interrupt and TMR13 global interrupt
45 TMR8_TRG_HALL_TMR14 (TMR8, TMR14) — TMR8 trigger and HALL interrupts and TMR14 global interrupt
46 TMR8_CH (TMR8) — TMR8 channel interrupt
47 EDMA_Stream8 (EDMA) — EDMA Stream8 global interrupt
48 XMC — XMC global interrupt
49 SDIO1 — SDIO1 global interrupt
50 TMR5 — TMR5 global interrupt
51 SPI3 — SPI3 global interrupt
52 UART4 — UART4 global interrupt
53 UART5 — UART5 global interrupt
54 TMR6_DAC (TMR6) — TMR6 and DAC interrupt
55 TMR7 — TMR7 global interrupt
56 DMA1_Channel1 (DMA1) — DMA1 Channel1 global interrupt
57 DMA1_Channel2 (DMA1) — DMA1 Channel2 global interrupt
58 DMA1_Channel3 (DMA1) — DMA1 Channel3 global interrupt
59 DMA1_Channel4 (DMA1) — DMA1 Channel4 global interrupt
60 DMA1_Channel5 (DMA1) — DMA1 Channel5 global interrupt
61 EMAC (ETHERNET_MAC) — Ethernet mac global interrupt
62 EMAC_WKUP (EXINT) — EMAC_WKUP interrupt connect to EXINT line19
63 CAN2_TX (CAN2) — CAN2 TX interrupt
64 CAN2_RX0 (CAN2) — CAN2 RX0 interrupt
65 CAN2_RX1 (CAN2) — CAN2 RX1 interrupt
66 CAN2_SE (CAN2) — CAN2 SE interrupt
67 OTGFS1 (USB_OTG1_GLOBAL) — USB On The Go FS global interrupt
68 DMA1_Channel6 (DMA1) — DMA1 Channel6 global interrupt
69 DMA1_Channel7 (DMA1) — DMA1 Channel7 global interrupt
71 USART6 — USART6 global interrupt
72 I2C3_EVT (I2C3) — I2C3 event interrupt
73 I2C3_ERR (I2C3) — I2C3 error interrupt
76 OTGFS2_WKUP (EXINT) — OTGFS2_WKUP interrupt connect to EXINT line20
77 OTGFS2 (USB_OTG2_GLOBAL) — USB On The Go FS2 global interrupt
78 DVP — DVP global interrupt
81 FPU — Floating point unit interrupt
82 UART7 — UART7 global interrupt
83 UART8 — UART8 global interrupt
84 SPI4 — SPI4 global interrupt
91 QSPI2 — QSPI2 global interrupt
92 QSPI1 — QSPI1 global interrupt
94 DMAMUX (DMA1) — DMAMUX global interrupt
102 SDIO2 — SDIO2 global interrupt
103 ACC — ACC interrupt
104 TMR20_BRK (TMR20) — TMR20 brake interrupt
105 TMR20_OVF (TMR20) — TMR20 overflow interrupt
106 TMR20_TRG_HALL (TMR20) — TMR20 trigger and HALL interrupts
107 TMR20_CH (TMR20) — TMR20 channel interrupt
108 DMA2_Channel1 (DMA2) — DMA2 Channel1 global interrupt
109 DMA2_Channel2 (DMA2) — DMA2 Channel2 global interrupt
110 DMA2_Channel3 (DMA2) — DMA2 Channel3 global interrupt
111 DMA2_Channel4 (DMA2) — DMA2 Channel4 global interrupt
112 DMA2_Channel5 (DMA2) — DMA2 Channel5 global interrupt
113 DMA2_Channel6 (DMA2) — DMA2 Channel6 global interrupt
114 DMA2_Channel7 (DMA2) — DMA2 Channel7 global interrupt
